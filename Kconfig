## Kconfig
```kconfig
menu "ESP Bytebeat Configuration"

    config ESP_BYTEBEAT_USE_DSP
        bool "Use the ESP-DSP square-root function"
        default y
        help
            Use dsps_sqrtf_f32 for square-root operations. Trigonometric and
            other math functions continue to use the standard C math library.
            The selected ESP-DSP implementation and its performance depend on
            the target and build configuration; no speedup is guaranteed.

            If disabled, sqrtf from the standard C math library is used.

endmenu
```

## examples/web_daw/main/Kconfig.projbuild
```kconfig
menu "Bytebeat DAW Configuration"

    config DAW_SAMPLE_RATE
        int "Audio Sample Rate (Hz)"
        default 48000
        help
            The target sample rate for the I2S output and QuickJS evaluation.

    config DAW_CHUNK_SIZE
        int "Audio Chunk Size (Samples per render)"
        default 512
        help
            Number of samples processed by QuickJS per iteration. Smaller sizes reduce latency but increase context switching overhead.

    config DAW_NUM_BUFFERS
        int "Number of Ring Buffers"
        default 40
        help
            Number of audio chunks allocated in PSRAM to prevent I2S underflow during heavy formula generation.

    config DAW_JS_CORE_ID
        int "QuickJS Worker Core ID"
        default 0
        help
            Which CPU core the QuickJS engine runs on.

    config DAW_COORD_CORE_ID
        int "Audio Coordinator Core ID"
        default 1
        help
            Which CPU core the Audio Coordinator (I2S writer) runs on.

    menu "Hardware Pins"
        config DAW_I2S_MCLK_GPIO
            int "I2S Master Clock (MCLK) GPIO"
            default 13

        config DAW_I2S_BCLK_GPIO
            int "I2S Bit Clock (BCLK) GPIO"
            default 12

        config DAW_I2S_WS_GPIO
            int "I2S Word Select (WS) GPIO"
            default 10

        config DAW_I2S_DOUT_GPIO
            int "I2S Data Out (DOUT) GPIO"
            default 9

        config DAW_I2C_SDA_GPIO
            int "I2C SDA GPIO (ES8311 Codec)"
            default 7

        config DAW_I2C_SCL_GPIO
            int "I2C SCL GPIO (ES8311 Codec)"
            default 8

        config DAW_PA_PIN_GPIO
            int "Power Amplifier Enable GPIO"
            default 53
    endmenu

endmenu
```

## examples/web_daw/sdkconfig.defaults
```kconfig
# ============================================================================
# ESP32-P4 Hardware Target Configuration
# ============================================================================
CONFIG_IDF_TARGET="esp32p4"
CONFIG_ESP32P4_SELECTS_REV_LESS_V3=y

# ============================================================================
# Flash Configuration (32 MB QIO Mode)
# ============================================================================
CONFIG_ESPTOOLPY_FLASHMODE_QIO=y
CONFIG_ESPTOOLPY_FLASHSIZE_32MB=y

# ============================================================================
# Partition Table
# ============================================================================
CONFIG_PARTITION_TABLE_CUSTOM=y
CONFIG_PARTITION_TABLE_CUSTOM_FILENAME="partitions.csv"

# ============================================================================
# PSRAM Configuration (Web DAW allocates render buffers in external PSRAM)
# ============================================================================
CONFIG_SPIRAM=y
CONFIG_SPIRAM_MODE_HEX=y
CONFIG_SPIRAM_SPEED_200M=y
CONFIG_SPIRAM_USE_MALLOC=y

# ============================================================================
# FreeRTOS Configuration
# ============================================================================
CONFIG_FREERTOS_HZ=1000

# ============================================================================
# Web DAW Component Configuration (Audio rendering and task scheduling)
# ============================================================================
CONFIG_DAW_SAMPLE_RATE=48000
CONFIG_DAW_CHUNK_SIZE=512
CONFIG_DAW_NUM_BUFFERS=40
CONFIG_DAW_JS_CORE_ID=0
CONFIG_DAW_COORD_CORE_ID=1

# ============================================================================
# ES8311 Audio Codec Pin Configuration
# ============================================================================
CONFIG_DAW_I2S_MCLK_GPIO=13
CONFIG_DAW_I2S_BCLK_GPIO=12
CONFIG_DAW_I2S_WS_GPIO=10
CONFIG_DAW_I2S_DOUT_GPIO=9
CONFIG_DAW_I2C_SDA_GPIO=7
CONFIG_DAW_I2C_SCL_GPIO=8
CONFIG_DAW_PA_PIN_GPIO=53
```
